## arch/lkl/configs/defconfig
```kconfig
CONFIG_SLUB=y
CONFIG_SLAB=n
CONFIG_SLUB_DEBUG=y
CONFIG_SLUB_DEBUG_ON=y
CONFIG_HAVE_ARCH_KASAN=y
CONFIG_KASAN=y
CONFIG_KASAN_OUTLINE=y
CONFIG_KASAN_INLINE=n
CONFIG_KASAN_TEST_ON_CHDIR=y
CONFIG_KASAN_PANIC_ON_ERROR=y
# CONFIG_LOCALVERSION_AUTO is not set
CONFIG_NO_HZ_IDLE=y
# CONFIG_SYSFS_SYSCALL is not set
CONFIG_KALLSYMS_USE_DATA_SECTION=y
CONFIG_KALLSYMS_ALL=y
# CONFIG_BASE_FULL is not set
# CONFIG_FUTEX is not set
# CONFIG_SIGNALFD is not set
# CONFIG_TIMERFD is not set
# CONFIG_AIO is not set
# CONFIG_ADVISE_SYSCALLS is not set
CONFIG_EMBEDDED=y
# CONFIG_VM_EVENT_COUNTERS is not set
# CONFIG_COMPAT_BRK is not set
# CONFIG_BLK_DEV_BSG is not set
CONFIG_NET=y
CONFIG_INET=y
# CONFIG_WIRELESS is not set
# CONFIG_UEVENT_HELPER is not set
# CONFIG_FW_LOADER is not set
CONFIG_VIRTIO_BLK=y
CONFIG_NETDEVICES=y
CONFIG_VIRTIO_NET=y
# CONFIG_ETHERNET is not set
# CONFIG_WLAN is not set
# CONFIG_VT is not set
CONFIG_VIRTIO_MMIO=y
CONFIG_VIRTIO_MMIO_CMDLINE_DEVICES=y
CONFIG_EXT4_FS=y
CONFIG_EXT4_FS_POSIX_ACL=y
CONFIG_EXT4_FS_SECURITY=y
CONFIG_XFS_FS=y
CONFIG_XFS_POSIX_ACL=y
CONFIG_BTRFS_FS=y
CONFIG_BTRFS_FS_POSIX_ACL=y
# CONFIG_FILE_LOCKING is not set
# CONFIG_DNOTIFY is not set
# CONFIG_INOTIFY_USER is not set
CONFIG_VFAT_FS=y
CONFIG_NLS_CODEPAGE_437=y
CONFIG_NLS_CODEPAGE_737=y
CONFIG_NLS_CODEPAGE_775=y
CONFIG_NLS_CODEPAGE_850=y
CONFIG_NLS_CODEPAGE_852=y
CONFIG_NLS_CODEPAGE_855=y
CONFIG_NLS_CODEPAGE_857=y
CONFIG_NLS_CODEPAGE_860=y
CONFIG_NLS_CODEPAGE_861=y
CONFIG_NLS_CODEPAGE_862=y
CONFIG_NLS_CODEPAGE_863=y
CONFIG_NLS_CODEPAGE_864=y
CONFIG_NLS_CODEPAGE_865=y
CONFIG_NLS_CODEPAGE_866=y
CONFIG_NLS_CODEPAGE_869=y
CONFIG_NLS_CODEPAGE_936=y
CONFIG_NLS_CODEPAGE_950=y
CONFIG_NLS_CODEPAGE_932=y
CONFIG_NLS_CODEPAGE_949=y
CONFIG_NLS_CODEPAGE_874=y
CONFIG_NLS_ISO8859_8=y
CONFIG_NLS_CODEPAGE_1250=y
CONFIG_NLS_CODEPAGE_1251=y
CONFIG_NLS_ASCII=y
CONFIG_NLS_ISO8859_1=y
CONFIG_NLS_ISO8859_2=y
CONFIG_NLS_ISO8859_3=y
CONFIG_NLS_ISO8859_4=y
CONFIG_NLS_ISO8859_5=y
CONFIG_NLS_ISO8859_6=y
CONFIG_NLS_ISO8859_7=y
CONFIG_NLS_ISO8859_9=y
CONFIG_NLS_ISO8859_13=y
CONFIG_NLS_ISO8859_14=y
CONFIG_NLS_ISO8859_15=y
CONFIG_NLS_KOI8_R=y
CONFIG_NLS_KOI8_U=y
CONFIG_NLS_MAC_ROMAN=y
CONFIG_NLS_MAC_CELTIC=y
CONFIG_NLS_MAC_CENTEURO=y
CONFIG_NLS_MAC_CROATIAN=y
CONFIG_NLS_MAC_CYRILLIC=y
CONFIG_NLS_MAC_GAELIC=y
CONFIG_NLS_MAC_GREEK=y
CONFIG_NLS_MAC_ICELAND=y
CONFIG_NLS_MAC_INUIT=y
CONFIG_NLS_MAC_ROMANIAN=y
CONFIG_NLS_MAC_TURKISH=y
CONFIG_NLS_UTF8=y
CONFIG_HZ_100=y
CONFIG_CRYPTO_ANSI_CPRNG=y
CONFIG_PRINTK_TIME=y
CONFIG_DEBUG_INFO=y
CONFIG_DEBUG_INFO_REDUCED=y
# CONFIG_ENABLE_WARN_DEPRECATED is not set
# CONFIG_ENABLE_MUST_CHECK is not set
CONFIG_NET=y
CONFIG_ETHERNET=y
CONFIG_WLAN=y
CONFIG_WIRELESS=y
CONFIG_CFG80211=y
CONFIG_MAC80211=y
CONFIG_COMPILE_TEST=y
CONFIG_AQTION=y
CONFIG_SCSI=y
CONFIG_SCSI_SNIC=y
CONFIG_8139CP=y
CONFIG_ETHERNET=y
CONFIG_ATH_COMMON=y
CONFIG_ATH9K_HW=y
CONFIG_ATH9K_COMMON=y
CONFIG_ATH9K=y
CONFIG_ATH9K_PCI=y
CONFIG_ATH10K=y
CONFIG_ATH10K_PCI=y
CONFIG_RTW88=y
CONFIG_RTW88_CORE=y
CONFIG_RTW88_8822BE=y
CONFIG_RTW88_8822CE=y
CONFIG_RTW88_PCI=y
CONFIG_RTW88_DEBUG=y
CONFIG_RTW88_DEBUGFS=y
CONFIG_STMMAC_ETH=y
CONFIG_STMMAC_PCI=y
CONFIG_STMMAC_PLATFORM=y
CONFIG_USB=y
CONFIG_RSI_91X=y
CONFIG_RSI_USB=y
CONFIG_AR5523=y
CONFIG_MWIFIEX=y
CONFIG_MWIFIEX_USB=y

#AUTO generated drivers/net/ethernet
CONFIG_MLXSW_CORE_HWMON=y
CONFIG_PCH_GBE=y
CONFIG_STMMAC_ETH=y
CONFIG_MV643XX_ETH=y
CONFIG_DWMAC_MESON=y
CONFIG_DWMAC_IPQ806X=y
CONFIG_SUNGEM=y
CONFIG_SKY2=y
CONFIG_ATP=y
# CONFIG_BE2NET=y
CONFIG_HAPPYMEAL=y
CONFIG_NI65=y
CONFIG_MLXSW_SPECTRUM=y
CONFIG_MLX5_ACCEL=y
CONFIG_MLX5_FPGA_TLS=y
CONFIG_ENC28J60=y
CONFIG_TI_CPSW_PHY_SEL=y
CONFIG_SMSC911X=y
CONFIG_LDMVSW=y
CONFIG_ARIADNE=y
CONFIG_ACENIC=y
CONFIG_SFC_FALCON_MTD=y
CONFIG_SFC_MTD=y
CONFIG_SUNLANCE=y
CONFIG_PCMCIA_NMCLAN=y
CONFIG_S2IO=y
CONFIG_NETXEN_NIC=y
CONFIG_BNX2=y
CONFIG_MACSONIC=y
CONFIG_PXA168_ETH=y
CONFIG_SMC91X=y
CONFIG_LANCE=y
CONFIG_STMMAC_PCI=y
CONFIG_MLXSW_CORE=y
CONFIG_SMC911X=y
CONFIG_MACB=y
CONFIG_SFC_FALCON=y
CONFIG_BNXT=y
CONFIG_VIA_VELOCITY=y
CONFIG_DWMAC_ANARION=y
CONFIG_DWMAC_SUNXI=y
CONFIG_MLX5_FPGA=y
CONFIG_TI_CPTS_MOD=y
CONFIG_EL3=y
CONFIG_MLXSW_MINIMAL=y
# CONFIG_QLCNIC=y
CONFIG_XTENSA_XT2000_SONIC=y
CONFIG_SGI_O2MACE_ETH=y
CONFIG_8139CP=y
CONFIG_TC35815=y
CONFIG_FEALNX=y
CONFIG_QED=y
CONFIG_MLX4_EN=y
CONFIG_A2065=y
CONFIG_HP100=y
CONFIG_SPIDER_NET=y
CONFIG_PCMCIA_3C574=y
# CONFIG_MLX4_CORE=y
CONFIG_SB1250_MAC=y
CONFIG_QEDE=y
CONFIG_TI_DAVINCI_MDIO=y
CONFIG_AMD8111_ETH=y
CONFIG_TI_DAVINCI_EMAC=y
CONFIG_AMD_XGBE=y
CONFIG_HPLANCE=y
CONFIG_VXGE=y
CONFIG_QLA3XXX=y
CONFIG_MLX5_EN_ARFS=y
CONFIG_TYPHOON=y
CONFIG_KORINA=y
CONFIG_JME=y
CONFIG_DM9102=y
CONFIG_MLX5_FPGA_IPSEC=y
CONFIG_LAN743X=y
CONFIG_SUNBMAC=y
CONFIG_SUNVNET_COMMON=y
CONFIG_SGI_IOC3_ETH=y
CONFIG_LANTIQ_ETOP=y
CONFIG_MLX5_ESWITCH=y
CONFIG_MLX5_CORE_IPOIB=y
CONFIG_BGMAC_PLATFORM=y
CONFIG_NET_TULIP=y
CONFIG_R6040=y
CONFIG_MLXSW_SWITCHIB=y
CONFIG_MLXSW_PCI=y
CONFIG_SLICOSS=y
CONFIG_MLX5_EN_RXNFC=y
CONFIG_TI_KEYSTONE_NETCP=y
CONFIG_SUN3LANCE=y
CONFIG_BCMGENET=y
CONFIG_CX_ECAT=y
CONFIG_MLXSW_SWITCHX2=y
CONFIG_NIU=y
CONFIG_PASEMI_MAC=y
CONFIG_CPMAC=y
CONFIG_TULIP=y
CONFIG_FORCEDETH=y
CONFIG_TI_CPSW=y
CONFIG_DWMAC_GENERIC=y
CONFIG_SIS190=y
CONFIG_TIGON3=y
CONFIG_BNX2X=y
CONFIG_MVPP2=y
CONFIG_PCMCIA_3C589=y
CONFIG_MLXSW_I2C=y
CONFIG_DWMAC_OXNAS=y
CONFIG_BCM63XX_ENET=y
CONFIG_SMSC9420=y
CONFIG_CASSINI=y
CONFIG_TLAN=y
CONFIG_SFC=y
CONFIG_ET131X=y
CONFIG_B44=y
CONFIG_VIA_RHINE=y
CONFIG_WINBOND_840=y
CONFIG_MLX5_EN_IPSEC=y
CONFIG_SC92031=y
CONFIG_SKGE=y
CONFIG_SUNVNET=y
CONFIG_SMC9194=y
CONFIG_ENCX24J600=y
CONFIG_MVME147_NET=y
CONFIG_ETHOC=y
CONFIG_PCMCIA_SMC91C92=y
CONFIG_NS83820=y
CONFIG_PCNET32=y
CONFIG_STMMAC_SELFTESTS=y
CONFIG_MVNETA_BM=y
CONFIG_DWMAC_ROCKCHIP=y
CONFIG_MVNETA=y
CONFIG_8139TOO=y
CONFIG_DWMAC_DWC_QOS_ETH=y
CONFIG_NET_NETX=y
CONFIG_DWMAC_LPC18XX=y
CONFIG_MLXSW_CORE_THERMAL=y
CONFIG_SUNQE=y
CONFIG_DWMAC_STM32=y
CONFIG_PCMCIA_XIRCOM=y
CONFIG_TI_KEYSTONE_NETCP_ETHSS=y
CONFIG_ROCKER=y
CONFIG_MLX5_CORE_EN=y
CONFIG_MLX5_CORE_EN_DCB=y
CONFIG_GELIC_NET=y
CONFIG_MACB_PCI=y
CONFIG_DWMAC_STI=y
CONFIG_GELIC_WIRELESS=y
CONFIG_DWMAC_SUN8I=y
CONFIG_BGMAC_BCMA=y
CONFIG_FSL_ENETC=y
CONFIG_BGMAC=y
CONFIG_MLX5_EN_TLS=y
CONFIG_SFC_SRIOV=y
CONFIG_DNET=y
CONFIG_MVMDIO=y
CONFIG_SIS900=y
CONFIG_DECLANCE=y
CONFIG_DWMAC_MEDIATEK=y
CONFIG_MIPS_JAZZ_SONIC=y
CONFIG_LANTIQ_XRX200=y
CONFIG_MACB_USE_HWSTAMP=y
# CONFIG_CNIC=y
CONFIG_ULI526X=y
CONFIG_MLXSW_SPECTRUM_DCB=y
# CONFIG_MLX5_CORE=y
CONFIG_DWC_XLGMAC=y
CONFIG_EPIC100=y
CONFIG_SYSTEMPORT=y
CONFIG_VORTEX=y
CONFIG_MLX4_EN_DCB=y
CONFIG_3C515=y
CONFIG_DWMAC_QCOM_ETHQOS=y
CONFIG_MIPS_AU1X00_ENET=y
CONFIG_ATARILANCE=y
CONFIG_QLGE=y
CONFIG_ARM_AM79C961A=y
CONFIG_BNA=y
CONFIG_MLX5_MPFS=y
CONFIG_DE2104X=y
CONFIG_FSL_ENETC_PTP_CLOCK=y
CONFIG_DWC_XLGMAC_PCI=y
CONFIG_NATSEMI=y
CONFIG_FSL_ENETC_VF=y
CONFIG_R8169=y
CONFIG_STMMAC_PLATFORM=y
CONFIG_ENIC=y
CONFIG_DE4X5=y

#AUTO generated drivers/net/wireless
CONFIG_P54_USB=y
CONFIG_BRCMFMAC_USB=y
CONFIG_LIBERTAS=y
CONFIG_ZD1211RW=y
CONFIG_ATH6KL_TRACING=y
CONFIG_APPLE_AIRPORT=y
CONFIG_RT2800_LIB_MMIO=y
CONFIG_ATH6KL_USB=y
CONFIG_ATH9K_STATION_STATISTICS=y
CONFIG_TMD_HERMES=y
CONFIG_RTL8192CU=y
CONFIG_ATH5K_PCI=y
CONFIG_RT2X00_LIB_LEDS=y
CONFIG_RT2X00_LIB=y
CONFIG_LIBERTAS_THINFIRM_USB=y
CONFIG_ATH10K_AHB=y
CONFIG_RT2500PCI=y
CONFIG_RTLWIFI=y
CONFIG_PCMCIA_WL3501=y
CONFIG_PCMCIA_ATMEL=y
CONFIG_RT2800USB=y
CONFIG_PCI_HERMES=y
CONFIG_P54_LEDS=y
CONFIG_VIRT_WIFI=y
CONFIG_ATH9K_DFS_CERTIFIED=y
CONFIG_ATH9K_DYNACK=y
CONFIG_ATH10K_PCI=y
CONFIG_IWLEGACY=y
CONFIG_WIL6210_DEBUGFS=y
CONFIG_USB_NET_RNDIS_WLAN=y
CONFIG_RTL8192EE=y
CONFIG_ORINOCO_USB=y
CONFIG_MT7601U=y
CONFIG_MT76x0U=y
CONFIG_RTW88_PCI=y
CONFIG_MWIFIEX_USB=y
CONFIG_RTL8821AE=y
CONFIG_P54_SPI=y
CONFIG_ATH6KL=y
CONFIG_BRCMFMAC=y
CONFIG_RT2800_LIB=y
CONFIG_BRCMFMAC_SDIO=y
CONFIG_RT2X00_LIB_MMIO=y
CONFIG_ATH10K_SNOC=y
CONFIG_RSI_DEBUGFS=y
CONFIG_ATH9K_HTC_DEBUGFS=y
CONFIG_RT2500USB=y
CONFIG_ATH10K_TRACING=y
CONFIG_RT2800PCI=y
CONFIG_RSI_COEX=y
CONFIG_RTLWIFI_PCI=y
CONFIG_RTL8192CE=y
CONFIG_LIBERTAS_SPI=y
CONFIG_ATH9K=y
CONFIG_MT76x2_COMMON=y
CONFIG_IWL3945=y
CONFIG_RT2X00_LIB_SOC=y
CONFIG_ATH9K_HWRNG=y
CONFIG_RTLBTCOEXIST=y
CONFIG_RTL8192DE=y
CONFIG_RTW88_8822BE=y
CONFIG_P54_PCI=y
CONFIG_ATH5K_AHB=y
CONFIG_LIBERTAS_MESH=y
CONFIG_RT2X00_LIB_FIRMWARE=y
CONFIG_ATH9K_COMMON_SPECTRAL=y
CONFIG_ATH10K_SPECTRAL=y
CONFIG_HERMES=y
CONFIG_ATH9K_DFS_DEBUGFS=y
CONFIG_RTL8188EE=y
CONFIG_LIBERTAS_USB=y
CONFIG_WIL6210=y
CONFIG_LIBERTAS_SDIO=y
CONFIG_ATH9K_BTCOEX_SUPPORT=y
CONFIG_P54_COMMON=y
CONFIG_ATMEL=y
CONFIG_MT76x0E=y
CONFIG_RT2800SOC=y
CONFIG_RT2X00_LIB_USB=y
CONFIG_ATH10K_USB=y
CONFIG_MT76x0_COMMON=y
CONFIG_ATH9K_COMMON_DEBUG=y
CONFIG_RT2X00_LIB_DEBUGFS=y
CONFIG_RT2X00_LIB_PCI=y
CONFIG_PLX_HERMES=y
CONFIG_MWIFIEX_PCIE=y
CONFIG_MWIFIEX_SDIO=y
CONFIG_MT7615E=y
CONFIG_ATH9K_PCOEM=y
CONFIG_ATH10K=y
CONFIG_IWLEGACY_DEBUGFS=y
CONFIG_ATH9K_PCI=y
CONFIG_IWL4965=y
CONFIG_ATH9K_WOW=y
CONFIG_MT7603E=y
CONFIG_PCMCIA_RAYCS=y
CONFIG_ATH9K_TX99=y
CONFIG_NORTEL_HERMES=y
CONFIG_BRCMFMAC_PROTO_BCDC=y
CONFIG_ATH6KL_SDIO=y
CONFIG_RT73USB=y
CONFIG_RT2400PCI=y
CONFIG_RTL8XXXU=y
CONFIG_AT76C50X_USB=y
CONFIG_USB_ZD1201=y
CONFIG_ADM8211=y
CONFIG_ATH9K_AHB=y
# CONFIG_MAC80211_HWSIM=y
CONFIG_ATH9K_COMMON=y
CONFIG_ATH10K_CE=y
CONFIG_MT76x2U=y
CONFIG_ATH9K_DEBUGFS=y
CONFIG_MWIFIEX=y
CONFIG_AR5523=y
CONFIG_RTLWIFI_USB=y
CONFIG_PCI_ATMEL=y
CONFIG_ATH10K_SDIO=y
CONFIG_BRCMFMAC_PROTO_MSGBUF=y
CONFIG_PCMCIA_SPECTRUM=y
CONFIG_CARL9170=y
CONFIG_RTW88_8822CE=y
CONFIG_RTL8192C_COMMON=y
CONFIG_PCMCIA_HERMES=y
CONFIG_RTL8723AE=y
CONFIG_RT61PCI=y
CONFIG_RTL8192SE=y
CONFIG_ATH5K=y
CONFIG_ZD1211RW_DEBUG=y
CONFIG_ATH5K_DEBUG=y
CONFIG_LIBERTAS_CS=y
CONFIG_BRCMFMAC_PCIE=y
CONFIG_RTL8723BE=y
CONFIG_RSI_USB=y
CONFIG_RTL8723_COMMON=y
CONFIG_ATH9K_HTC=y
CONFIG_ATH9K_HW=y
CONFIG_LIBERTAS_THINFIRM=y
CONFIG_RSI_SDIO=y
CONFIG_WIL6210_TRACING=y
CONFIG_RSI_91X=y
CONFIG_RTW88_CORE=y
CONFIG_MT76x2E=y
CONFIG_CARL9170_DEBUGFS=y
CONFIG_RT2X00_LIB_CRYPTO=y
```
